#include "hal_rpm_capture.h"
#include "hal_board_config.h"
#include "hal_serial.h"

#include <Arduino.h>
#include <stdio.h>

#include "driver/pulse_cnt.h"
#include "driver/mcpwm_cap.h"
#include "esp_err.h"


// ============================================================
// HAL RPM Capture Service
// ============================================================
//
// Hardware-assisted Hall capture for ESP32 / ESP-IDF 5.4.x.
//
// PCNT:
//   Counts every rising Hall edge in hardware.
//
// MCPWM Capture:
//   Latches the hardware timer value on each rising Hall edge.
//
// ESP-IDF 5.4.x does not provide mcpwm_capture_get_latched_value().
// Therefore the MCPWM driver callback copies the already-latched
// hardware timestamp into a volatile variable.
//
// IMPORTANT:
// The timestamp itself is generated by hardware at the Hall edge;
// callback latency does not alter that captured timestamp.
//
// PCNT independently counts the Hall edges. If software/callback
// servicing is delayed, the period is calculated as:
//
//     period = delta_capture_time / delta_pulse_count
//
// Hall assumption:
//   1 rising edge = 1 revolution.
//
// ============================================================


static constexpr uint32_t BASELINE_RESET_TIMEOUT_US = 500000U;


// PCNT limits. accum_count extends the hardware counter when
// these limits are crossed.
static constexpr int PCNT_HIGH_LIMIT = 30000;
static constexpr int PCNT_LOW_LIMIT  = -30000;


// ------------------------------------------------------------
// PCNT resources
// ------------------------------------------------------------

static pcnt_unit_handle_t g_pcntUnit = nullptr;
static pcnt_channel_handle_t g_pcntChannel = nullptr;


// ------------------------------------------------------------
// MCPWM capture resources
// ------------------------------------------------------------

static mcpwm_cap_timer_handle_t g_capTimer = nullptr;
static mcpwm_cap_channel_handle_t g_capChannel = nullptr;

static uint32_t g_capTimerResolutionHz = 0U;


// ------------------------------------------------------------
// MCPWM ISR callback data
// ------------------------------------------------------------
//
// These variables are written by the MCPWM driver callback.
// The capture timestamp in edata->cap_value was latched by
// hardware at the actual Hall edge.
//
static volatile uint32_t g_latestCaptureTicks = 0U;
static volatile uint32_t g_captureEventCount = 0U;


// ------------------------------------------------------------
// Measurement state
// ------------------------------------------------------------

static bool g_initialized = false;
static bool g_haveBaseline = false;

static uint32_t g_previousPulseCount = 0U;
static uint32_t g_previousCaptureTicks = 0U;
static uint32_t g_previousCaptureEventCount = 0U;

static uint32_t g_lastPulseObservedUs = 0U;


// ------------------------------------------------------------
// Diagnostic state
// ------------------------------------------------------------

static uint32_t g_pulseCount = 0U;
static uint32_t g_edgesForLastPeriod = 0U;


// ============================================================
// MCPWM capture callback
// ============================================================
//
// Called in ISR context by the ESP-IDF MCPWM driver.
//
// Do the absolute minimum here:
//   - copy the HARDWARE captured timer value
//   - increment a sequence counter
//
// No micros(), Serial, blocking operation or application logic.
//
// ============================================================

static bool IRAM_ATTR rpmCaptureCallback(
    mcpwm_cap_channel_handle_t capChannel,
    const mcpwm_capture_event_data_t* eventData,
    void* userData)
{
    (void)capChannel;
    (void)userData;

    g_latestCaptureTicks =
        eventData->cap_value;

    ++g_captureEventCount;

    return false;
}


// ============================================================
// Initialization diagnostic helper
// ============================================================

static bool checkEspResult(
    const char* step,
    esp_err_t result)
{
    if (result == ESP_OK)
    {
        return true;
    }

    char buffer[144];

    snprintf(
        buffer,
        sizeof(buffer),
        "RPM HW INIT FAIL: %s -> %s (%d)",
        step,
        esp_err_to_name(result),
        static_cast<int>(result)
    );

    halSerialPrintln(buffer);

    return false;
}


// ============================================================
// Read a stable software/hardware snapshot
// ============================================================
//
// We cannot use mcpwm_capture_get_latched_value() because it is
// not available in ESP-IDF 5.4.x.
//
// The callback exposes the last hardware capture value. To avoid
// reading while a new Hall edge/callback is updating it, take:
//
//   callback sequence A
//   capture timestamp
//   PCNT count A
//   callback sequence B
//   PCNT count B
//
// Accept only if both sequence and PCNT count remained stable.
//
// No interrupts are disabled.
//
// ============================================================

static bool readHardwareSnapshot(
    uint32_t& pulseCount,
    uint32_t& captureTicks,
    uint32_t& captureEventCount)
{
    if (!g_initialized)
    {
        return false;
    }

    for (uint32_t attempt = 0U;
         attempt < 5U;
         ++attempt)
    {
        const uint32_t eventCountA =
            g_captureEventCount;

        const uint32_t captured =
            g_latestCaptureTicks;

        int countA = 0;
        int countB = 0;

        if (pcnt_unit_get_count(
                g_pcntUnit,
                &countA) != ESP_OK)
        {
            return false;
        }

        const uint32_t eventCountB =
            g_captureEventCount;

        if (pcnt_unit_get_count(
                g_pcntUnit,
                &countB) != ESP_OK)
        {
            return false;
        }

        if ((eventCountA == eventCountB) &&
            (countA == countB))
        {
            pulseCount =
                static_cast<uint32_t>(countB);

            captureTicks =
                captured;

            captureEventCount =
                eventCountB;

            return true;
        }
    }

    return false;
}


// ============================================================
// Initialization
// ============================================================

void halRpmCaptureInit()
{
    g_initialized = false;
    g_haveBaseline = false;

    g_previousPulseCount = 0U;
    g_previousCaptureTicks = 0U;
    g_previousCaptureEventCount = 0U;
    g_lastPulseObservedUs = 0U;

    g_pulseCount = 0U;
    g_edgesForLastPeriod = 0U;

    g_latestCaptureTicks = 0U;
    g_captureEventCount = 0U;

    g_capTimerResolutionHz = 0U;


    // --------------------------------------------------------
    // PCNT unit
    // --------------------------------------------------------

    pcnt_unit_config_t unitConfig = {};

    unitConfig.high_limit =
        PCNT_HIGH_LIMIT;

    unitConfig.low_limit =
        PCNT_LOW_LIMIT;

    unitConfig.flags.accum_count = 1U;


    esp_err_t result =
        pcnt_new_unit(
            &unitConfig,
            &g_pcntUnit
        );

    if (!checkEspResult(
            "pcnt_new_unit",
            result))
    {
        return;
    }


    // --------------------------------------------------------
    // PCNT channel
    // --------------------------------------------------------

    pcnt_chan_config_t channelConfig = {};

    channelConfig.edge_gpio_num =
        PIN_RPM_SENSOR;

    channelConfig.level_gpio_num =
        -1;


    result =
        pcnt_new_channel(
            g_pcntUnit,
            &channelConfig,
            &g_pcntChannel
        );

    if (!checkEspResult(
            "pcnt_new_channel",
            result))
    {
        return;
    }


    // Rising edge increments; falling edge ignored.

    result =
        pcnt_channel_set_edge_action(
            g_pcntChannel,
            PCNT_CHANNEL_EDGE_ACTION_INCREASE,
            PCNT_CHANNEL_EDGE_ACTION_HOLD
        );

    if (!checkEspResult(
            "pcnt_channel_set_edge_action",
            result))
    {
        return;
    }


    // No control/level GPIO is used.

    result =
        pcnt_channel_set_level_action(
            g_pcntChannel,
            PCNT_CHANNEL_LEVEL_ACTION_KEEP,
            PCNT_CHANNEL_LEVEL_ACTION_KEEP
        );

    if (!checkEspResult(
            "pcnt_channel_set_level_action",
            result))
    {
        return;
    }


    // --------------------------------------------------------
    // PCNT overflow compensation
    // --------------------------------------------------------

    result =
        pcnt_unit_add_watch_point(
            g_pcntUnit,
            PCNT_HIGH_LIMIT
        );

    if (!checkEspResult(
            "pcnt_add_watch_high",
            result))
    {
        return;
    }


    result =
        pcnt_unit_add_watch_point(
            g_pcntUnit,
            PCNT_LOW_LIMIT
        );

    if (!checkEspResult(
            "pcnt_add_watch_low",
            result))
    {
        return;
    }


    // ESP-IDF requires a clear after adding watch points.

    result =
        pcnt_unit_clear_count(
            g_pcntUnit
        );

    if (!checkEspResult(
            "pcnt_unit_clear_count",
            result))
    {
        return;
    }


    // --------------------------------------------------------
    // MCPWM capture timer
    // --------------------------------------------------------

    mcpwm_capture_timer_config_t capTimerConfig = {};

    capTimerConfig.group_id = 0;

    capTimerConfig.clk_src =
        MCPWM_CAPTURE_CLK_SRC_DEFAULT;

    // On classic ESP32 / IDF 5.4.x this is effectively the APB
    // capture clock. Read the actual value from the driver below.
    capTimerConfig.resolution_hz = 0U;


    result =
        mcpwm_new_capture_timer(
            &capTimerConfig,
            &g_capTimer
        );

    if (!checkEspResult(
            "mcpwm_new_capture_timer",
            result))
    {
        return;
    }


    // --------------------------------------------------------
    // MCPWM capture channel
    // --------------------------------------------------------

    mcpwm_capture_channel_config_t capChannelConfig = {};

    capChannelConfig.gpio_num =
        PIN_RPM_SENSOR;

    capChannelConfig.prescale = 1U;

    capChannelConfig.flags.pos_edge = true;
    capChannelConfig.flags.neg_edge = false;


    result =
        mcpwm_new_capture_channel(
            g_capTimer,
            &capChannelConfig,
            &g_capChannel
        );

    if (!checkEspResult(
            "mcpwm_new_capture_channel",
            result))
    {
        return;
    }


    // --------------------------------------------------------
    // Register MCPWM capture callback
    // --------------------------------------------------------
    //
    // IDF 5.4.x obtains cap_value through this callback.
    // Registration must occur before channel enable.
    //

    mcpwm_capture_event_callbacks_t callbacks = {};

    callbacks.on_cap =
        rpmCaptureCallback;


    result =
        mcpwm_capture_channel_register_event_callbacks(
            g_capChannel,
            &callbacks,
            nullptr
        );

    if (!checkEspResult(
            "mcpwm_register_callback",
            result))
    {
        return;
    }


    // --------------------------------------------------------
    // Enable MCPWM capture
    // --------------------------------------------------------

    result =
        mcpwm_capture_channel_enable(
            g_capChannel
        );

    if (!checkEspResult(
            "mcpwm_capture_channel_enable",
            result))
    {
        return;
    }


    result =
        mcpwm_capture_timer_enable(
            g_capTimer
        );

    if (!checkEspResult(
            "mcpwm_capture_timer_enable",
            result))
    {
        return;
    }


    result =
        mcpwm_capture_timer_start(
            g_capTimer
        );

    if (!checkEspResult(
            "mcpwm_capture_timer_start",
            result))
    {
        return;
    }


    result =
        mcpwm_capture_timer_get_resolution(
            g_capTimer,
            &g_capTimerResolutionHz
        );

    if (!checkEspResult(
            "mcpwm_capture_timer_get_resolution",
            result))
    {
        return;
    }


    if (g_capTimerResolutionHz == 0U)
    {
        halSerialPrintln(
            "RPM HW INIT FAIL: capture resolution is zero"
        );

        return;
    }


    // --------------------------------------------------------
    // Start PCNT after both peripherals are configured
    // --------------------------------------------------------

    result =
        pcnt_unit_enable(
            g_pcntUnit
        );

    if (!checkEspResult(
            "pcnt_unit_enable",
            result))
    {
        return;
    }


    result =
        pcnt_unit_start(
            g_pcntUnit
        );

    if (!checkEspResult(
            "pcnt_unit_start",
            result))
    {
        return;
    }


    g_initialized = true;


    char buffer[120];

    snprintf(
        buffer,
        sizeof(buffer),
        "RPM HW INIT: PCNT+MCPWM OK capHz=%lu",
        static_cast<unsigned long>(
            g_capTimerResolutionHz)
    );

    halSerialPrintln(buffer);
}


// ============================================================
// Read captured period
// ============================================================

bool halRpmCaptureGetPeriodUs(
    uint32_t& periodUs)
{
    uint32_t currentPulseCount = 0U;
    uint32_t currentCaptureTicks = 0U;
    uint32_t currentCaptureEventCount = 0U;


    if (!readHardwareSnapshot(
            currentPulseCount,
            currentCaptureTicks,
            currentCaptureEventCount))
    {
        return false;
    }


    g_pulseCount =
        currentPulseCount;


    const uint32_t nowUs =
        micros();


    // --------------------------------------------------------
    // No new MCPWM capture event
    // --------------------------------------------------------

    if (g_haveBaseline &&
        (currentCaptureEventCount ==
         g_previousCaptureEventCount))
    {
        if ((uint32_t)(
                nowUs -
                g_lastPulseObservedUs) >=
            BASELINE_RESET_TIMEOUT_US)
        {
            g_haveBaseline = false;
            g_edgesForLastPeriod = 0U;
        }

        return false;
    }


    // --------------------------------------------------------
    // First captured edge after startup / long stop
    // --------------------------------------------------------

    if (!g_haveBaseline)
    {
        if ((currentPulseCount == 0U) ||
            (currentCaptureEventCount == 0U))
        {
            return false;
        }

        g_previousPulseCount =
            currentPulseCount;

        g_previousCaptureTicks =
            currentCaptureTicks;

        g_previousCaptureEventCount =
            currentCaptureEventCount;

        g_lastPulseObservedUs =
            nowUs;

        g_haveBaseline = true;

        g_edgesForLastPeriod = 0U;

        return false;
    }


    // --------------------------------------------------------
    // One or more new Hall edges
    // --------------------------------------------------------

    const uint32_t deltaPulses =
        currentPulseCount -
        g_previousPulseCount;


    if ((deltaPulses == 0U) ||
        (currentCaptureTicks ==
         g_previousCaptureTicks))
    {
        return false;
    }


    const uint32_t deltaTicks =
        currentCaptureTicks -
        g_previousCaptureTicks;


    // --------------------------------------------------------
    // Convert average ticks / pulse to us / pulse
    // --------------------------------------------------------

    const uint64_t numerator =
        static_cast<uint64_t>(
            deltaTicks) *
        1000000ULL;


    const uint64_t denominator =
        static_cast<uint64_t>(
            g_capTimerResolutionHz) *
        static_cast<uint64_t>(
            deltaPulses);


    if (denominator == 0ULL)
    {
        return false;
    }


    const uint32_t candidatePeriodUs =
        static_cast<uint32_t>(
            (numerator +
             (denominator / 2ULL)) /
            denominator
        );


    // --------------------------------------------------------
    // Update coherent baseline
    // --------------------------------------------------------

    g_previousPulseCount =
        currentPulseCount;

    g_previousCaptureTicks =
        currentCaptureTicks;

    g_previousCaptureEventCount =
        currentCaptureEventCount;

    g_lastPulseObservedUs =
        nowUs;

    g_edgesForLastPeriod =
        deltaPulses;




    periodUs =
        candidatePeriodUs;

    return true;
}


// ============================================================
// Diagnostic helpers
// ============================================================

uint32_t halRpmCaptureGetPulseCount()
{
    return g_pulseCount;
}


uint32_t halRpmCaptureGetEdgesForLastPeriod()
{
    return g_edgesForLastPeriod;
}
